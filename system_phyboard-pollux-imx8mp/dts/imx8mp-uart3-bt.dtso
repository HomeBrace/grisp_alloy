// SPDX-License-Identifier: GPL-2.0
/*
 * Enable UART3 for the PEB-WLBT-05 Sterling LWB Bluetooth controller in
 * raw-HCI mode.
 *
 * Based on the Phytec PEB-WLBT-05 overlay but WITHOUT the `bluetooth`
 * subnode, so the kernel's `hci_bcm` driver does not claim the UART.
 * Userspace (e.g. BlueHeron) talks HCI directly over /dev/ttymxc2.
 *
 * BT power-on (shutdown GPIO2_7) is handled by userspace via gpio-cdev
 * before opening the UART.
 *
 * Copyright (C) 2025 Homebrace GmbH
 */

/dts-v1/;
/plugin/;

#include <dt-bindings/clock/imx8mp-clock.h>
#include <dt-bindings/gpio/gpio.h>

#include "imx8mp-pinfunc.h"

/* UART3 — Sterling LWB Bluetooth HCI (raw, no kernel driver) */
&uart3 {
	assigned-clocks = <&clk IMX8MP_CLK_UART3>;
	assigned-clock-parents = <&clk IMX8MP_SYS_PLL1_80M>;
	dma-names = "";
	dmas = <0>;
	pinctrl-names = "default";
	pinctrl-0 = <&pinctrl_uart3_bt>;
	uart-has-rtscts;
	status = "okay";

	/* No "bluetooth" subnode — userspace manages HCI directly. */
};

&iomuxc {

	/* UART3 TX/RX + RTS/CTS for BT HCI */
	pinctrl_uart3_bt: uart3grp_bt {
		fsl,pins = <
			MX8MP_IOMUXC_UART3_RXD__UART3_DCE_RX		0x140
			MX8MP_IOMUXC_UART3_TXD__UART3_DCE_TX		0x140
			MX8MP_IOMUXC_SD1_RESET_B__UART3_DCE_RTS	0x140
			MX8MP_IOMUXC_SD1_STROBE__UART3_DCE_CTS		0x140
		>;
	};

	/* BT control GPIOs (directly managed by userspace) */
	pinctrl_bt: btgrp {
		fsl,pins = <
			MX8MP_IOMUXC_SD1_DATA4__GPIO2_IO06	0x10  /* BT_DEV_WAKE */
			MX8MP_IOMUXC_SD1_DATA5__GPIO2_IO07	0x10  /* BT_REG_ON (shutdown) */
			MX8MP_IOMUXC_SD1_DATA7__GPIO2_IO09	0x10  /* BT_HOST_WAKE */
		>;
	};
};
